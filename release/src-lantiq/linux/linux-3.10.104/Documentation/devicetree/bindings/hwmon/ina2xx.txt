## release/src-lantiq/linux/linux-3.10.104/Documentation/devicetree/bindings/hwmon/ina2xx.txt
```
Device Tree settings for Texas Instruments INA219, INA226 power monitor chips
--------------------------------
"ti,ina219":
The INA219 is a high-side current shunt and power monitor with an I2C interface.
The INA219 monitors shunt drop and supply voltage, with programmable conversion
times, filtering and calibration. Internal multiplier enable direct readouts of
current in ampers and power in watts.

Required properties:
- "compatible" value : one of
      "ti,ina219"
      "ti,ina226"
- "reg" value        : I2C address

Optional properties:
- "shunt-resistor"   : shunt resistor value in mico-Ohm
- "rail-name"        : define a name for the measured power rail, e.g. VDD_3V3
- "user-calibration" : define user calibration data; overwrite default vaules for higher accuracy
                       < param1 param2 param3 param4 > (4 int32 values must be given)
                       param1 = calibration factor [R5], param2 = configuration register [R0]
                       param3 = current_lsb [uA], param4 = power_lsb [uW] 


Example: "ti,ina219"
&i2c {
    status = "okay";

    ina219@48 {
        compatible = "ti,ina219";
        reg = <0x48>;
        shunt-resistor = <10000>;
        rail-name = "           PWR_12V ";
    };
}

Example: "ti,ina219" with user calibration
    status = "okay";

    ina219@48 {
        compatible = "ti,ina219";
        reg = <0x48>;
        shunt-resistor = <10000>;
        user-calibration = <27306 0x019F 15 300>;
        rail-name = "           PWR_12V ";
    };
}
```

## release/src-lantiq/linux/linux-3.10.104/Documentation/devicetree/bindings/regulator/tps65273.txt
```
TPS65273 regulators
Dual synchronous step-down converter with i2c controlled vid and current sharing.
4.5-V to 18-V Wide Input Voltage Range. Output Voltage from 0.68 V to 1.95 V
with 10-mV Steps for Each Buck; Output Voltage can also be Set By Resistor 
Divider. 

Required properties:
- compatible: "ti,tps65273"
- reg: I2C slave address
- regulators: A node that houses a sub-node for each regulator within the
  device. The tps65273 is a dual-synchronous DC-DC so it will create two
  regulator devices on the system. Each sub-node is identified using the node's
  name, with valid values listed below. The content of each sub-node is defined
  by the standard binding for regulators; see regulator.txt.

Optional properties:
- vout_slew_rate: Programmable Slew Rate Control for Output Voltage.
- vout_psm_mode: Pulse Skipping Mode to achieve high efficiency in light load.
- regulator-always-on: boolean, regulator should never be disabled

Example:

	tps65273@62 {
		compatible = "ti,tps65273";
		reg = <0x62>;

		regulators {
			dcdc1 {
				regulator-name = "1V1VDD";
				regulator-always-on;
				vout_slew_rate = <0>; 
				vout_psm_mode  = <0>;
			};
			dcdc2 {
				regulator-name = "1V5VDD";
				vout_slew_rate = <0>; 
				vout_psm_mode  = <0>; 
			};
		};
	};
```

## release/src-lantiq/linux/linux-3.10.104/arch/mips/lantiq/Kconfig
```kconfig
if LANTIQ

config SOC_TYPE_XWAY
	bool
	select PINCTRL_XWAY
	select USB_ARCH_HAS_HCD
	default n

choice
	prompt "SoC Type"
	default SOC_XWAY

config SOC_AMAZON_SE
	bool "Amazon SE"
	select SOC_TYPE_XWAY

config SOC_XWAY
	bool "XWAY"
	select SOC_TYPE_XWAY
	select HW_HAS_PCI
	select ARCH_SUPPORTS_MSI
	select ARCH_HAS_RESET_CONTROLLER
	select RESET_CONTROLLER

config SOC_FALCON
	bool "FALCON"
	select PINCTRL_FALCON

config SOC_GRX500
	bool "GRX500"
	select HW_HAS_PCI
	select ARCH_SUPPORTS_MSI
	select ARCH_HAS_RESET_CONTROLLER
	select RESET_CONTROLLER

config SOC_GRX500_BOOTCORE
	bool "GRX500_BOOTCORE"

endchoice

menu "Emulator Support"
config USE_EMULATOR
	bool "Support for FPGA emulation platform"
	default no
	help
	Use FPGA emulator as platform

choice
	prompt "Emulator"
	depends on USE_EMULATOR
	default USE_PALLADIUM

config USE_HAPS
	bool "HAPS"

config USE_PALLADIUM
	bool "Palladium"

endchoice
endmenu

choice
	prompt "Devicetree"

config DT_EASY50712
	bool "Easy50712"
	depends on SOC_XWAY

endchoice

choice 
	prompt "TOS_SIZE"
	depends on SOC_GRX500_BOOTCORE
	default TOS_SIZE_32M
config TOS_SIZE_16M
	bool "16M tos size"

config TOS_SIZE_32M
	bool "32M tos size"

config TOS_SIZE_64M
	bool "64M tos size"

config TOS_SIZE_128M
	bool "128M tos size"
endchoice


config PCI_LANTIQ_BOOT
	bool "PCI Boot Support"
	depends on SOC_XWAY && PCI && !PCI_LANTIQ
	default n
	---help---
	PCI bonding boot used for DSL off-chip bonding. Only xRX200 platform is
	supported To use this option, xRX200 family board and bonding daughter
	board must connect each other.

config PCI_LANTIQ
	bool "PCI Support"
	depends on SOC_XWAY && PCI

config PCIE_LANTIQ
	bool "PCIE Support"
	depends on (SOC_XWAY || SOC_GRX500) && PCI

config PCIE_LANTIQ_MSI
	bool
	depends on PCIE_LANTIQ && PCI_MSI
	default y

config XRX200_PHY_FW
	bool "XRX200 PHY firmware loader"
	depends on SOC_XWAY

config XRX500_PHY_FW
	bool "XRX500 PHY firmware loader"
	depends on SOC_GRX500

endif
```

## release/src-lantiq/linux/linux-3.10.104/drivers/atm/lantiq/Kconfig
```kconfig
config LTQ_ATM
	tristate "Lantiq ATM driver"
	depends on LANTIQ && ATM
	default n
	---help---
	Use this exclusively with PTM mode or Acceleration Package

config LTQ_ATM_TASKLET
	bool "Support Tasklet"
	depends on LTQ_ATM
	default y
	---help---
	Use tasklet handle incoming packet. Impact on ATM RX traffic performance.

config LTQ_ATM_RETX
	bool "Support ReTX"
	depends on LTQ_ATM && (LTQ_ATM_XRX300 || LTQ_ATM_XRX200)
	default n
	---help---
	Support Retransmission.

choice
   prompt "ATM Platform Selection"
   default LTQ_ATM_XRX300

   config LTQ_ATM_XRX200
   depends on LTQ_ATM
   bool "xRX200"

   config LTQ_ATM_XRX300
   depends on LTQ_ATM
   bool "xRX300"
endchoice
```

## release/src-lantiq/linux/linux-3.10.104/drivers/crypto/Kconfig.grx500
```kconfig
config CRYPTO_DEV_LANTIQ_EIP97
  tristate "Support Lantiq Crypto"
  depends on LANTIQ && SOC_GRX500

config LTQ_CRYPTO
  tristate "Lantiq Crypto Hardware support"
  depends on CRYPTO_DEV_LANTIQ_EIP97
  select CRYPTO_AUTHENC
  select CRYPTO_SHA1
  select CRYPTO_SHA256
  select CRYPTO_SHA512
  select CRYPTO_MD5
  select CRYPTO_AES
  select CRYPTO_DES
  select CRYPTO_MANAGER_DISABLE_TESTS
  
  default n 

config LTQ_CRYPTO_TEST
  tristate "Lantiq Crypto Test"
  depends on m && LTQ_CRYPTO
  help
  	Test suites for the hw crypto algs

config LTQ_MPE_IPSEC_SUPPORT
  bool
  depends on LTQ_PPA_MPE_IP97
  default y

config LTQ_CRYPTO_MAX_RING_USED
  int "Maximum number of ring used in the driver"
  default "4" if LTQ_MPE_IPSEC_SUPPORT
  default "2"
  help
    Number of rings used in the driver. By default, the driver supports up to
    two rings. However, if MPE firmware is used, we only use 1 ring in the driver

config CRYPTO_DEV_LANTIQ_EIP123
   tristate "Support Lantiq EIP123 hardware crypto engine"
   depends on LANTIQ && SOC_GRX500_BOOTCORE
   default n
   help
      Selects Hardware accelerated EIP123 crypto drivers.
```

## release/src-lantiq/linux/linux-3.10.104/drivers/net/ethernet/intel/vrx518/Kconfig
```kconfig
#
# Intel VRX518 device configuration
#

config VRX518_TC
    tristate "Intel(R) VRX518 DSL TC support"
    depends on VRX518
    ---help---
      This driver supports Intel(R) VRX518 DSL TC functions.
      it support ATM mode, PTM mode and PTM bonding mode.

      Bonding packet's scatter-gathering requires SoC HW support.

source "drivers/net/ethernet/intel/vrx518/tc/Kconfig"
```

## release/src-lantiq/linux/linux-3.10.104/drivers/net/ethernet/intel/vrx518/tc/Kconfig
```kconfig
#
# Intel VRX518 TC driver configuration
#
choice
    prompt "SoC Platform Selection"
    depends on VRX518_TC
    default VRX518_GRX500

    config VRX518_GRX500
       depends on SOC_GRX500_A21
       bool "GRX500"
       ---help---
       This selection works on intel GRX5XX SoC platform
       It requests datapath library, DMA driver, CBM driver and
       UMT driver support.
       It works without DC_DP function.

    config VRX518_DC_DP
       depends on LTQ_DIRECTCONNECT_DP
       bool "DC_DP"
       ---help---
       This selection works on any platform which has DC_DP lib.
       It should be able to work on any one of below mode:
       1. fast path
       2. directpath
       3. CPU path

    config VRX518_CPU
       bool "CPU path"
       ---help---
       This selection works on any platform.
       It has no dependency on any other library/function except linux kernel.

       It still requires Intel MEI driver to make VRX518 DSL working.

endchoice
```

## release/src-lantiq/linux/linux-3.10.104/drivers/net/ethernet/lantiq/Kconfig
```kconfig
config NET_VENDOR_LANTIQ
        bool "Lantiq network devices"
        default y
        depends on  SOC_XWAY || SOC_GRX500
        ---help---
          If you have a network (Ethernet) card belonging to this class, say Y
          and read the Ethernet-HOWTO, available from
          <http://www.tldp.org/docs.html#howto>.

if NET_VENDOR_LANTIQ

config LANTIQ_VRX318
	tristate "VRX318 SmartPHY PCIe EP driver"
	depends on PCIE_LANTIQ
	default n
	---help---
	Supported VRX318 smartPHY PCIe EP

config LANITQ_VRX318_PCIE_SWITCH_DSL_BONDING
	tristate "VRX318 SmartPHY DSL bonding with PCIe Switch"
	depends on LANTIQ_VRX318
	default n
	---help---
	Supported VRX318 smartPHY PCIe DSL Bonding with PCIe switch

config LANTIQ_ETH_FRAMEWORK
	bool "Lantiq framework for ethernet drivers"
	depends on LANTIQ
	default n
	---help---
	Lantiq framework for ethernet drivers

config LTQ_ETH_XRX500
        tristate "Lantiq Ethernet driver for XRX500 series"
        depends on LANTIQ && SOC_GRX500 && LTQ_ETHSW_API && (LTQ_CBM || LTQ_DATAPATH_LIBRARY)
        default n
        ---help---
        Lantiq Ethernet driver for XRX500 series.

config XRX500_ETH_DRV_COC_SUPPORT
		bool "CoC support in the ethernet driver"
        depends on LTQ_ETH_XRX500 && LTQ_DATAPATH_CPUFREQ && LTQ_CPUFREQ
		default y
		---help---
		CoC support in the Ethernet driver of XRX500 series

config HGU_BONDING
 	bool "Enable ethernet bonding for GRX500 HGU boards"
	depends on LTQ_ETH_XRX500
	default n
	---help---
	Lantiq HGU ethernet bonding enable

config HGU_BOND_PORT
	int "Bonded port number"
	depends on HGU_BONDING
	default 1
	---help---
	   This is the PAE port to be used as bond port along with the port 15 
	   to provide 2Gbps ethernet bond port for downstream traffic.

config SW_ROUTING_MODE
        bool "Enable the SW routing mode in ethernet driver"
	depends on LTQ_ETH_XRX500
	default y
        ---help---
        Lantiq Ethernet driver routing mode

config HAPS_CPU_LOOPBACK_TEST 
        bool "Enable CPU enqueue and dequeue loopback"
	depends on LTQ_ETH_XRX500
	default n
        ---help---
        Lantiq Ethernet driver CPU Enqueue and Dequeue test

config LTQ_ETH_OAM
  tristate "Ethernet OAM Handler"
  depends on LANTIQ
  ---help---
     This feature helps to create a eth oam virtual netdevice and handle the dot1agd control packets.

config LTQ_TOE_DRIVER
	bool "Enable the TOE (TCP Offload Engine) driver for XRX500"
        depends on LTQ_ETH_XRX500
        default n
        ---help---
        Lantiq TOE (TCP Offload Engine) driver for XRX500 series.
config OFFLOAD_FWD_MARK
	bool "Enable offload fwd mark for the packets already forwarded by switch"
				depends on LTQ_ETH_XRX500
				default y
				---help---
				Lantiq switch offload for broadcast/multicast packets

source "drivers/net/ethernet/lantiq/datapath/Kconfig"
source "drivers/net/ethernet/lantiq/switch-api/Kconfig"
source "drivers/net/ethernet/lantiq/tmu/Kconfig"
source "drivers/net/ethernet/lantiq/cbm/Kconfig"
source "drivers/net/ethernet/lantiq/vrx318/Kconfig"
source "drivers/net/ethernet/lantiq/directconnect_dp/Kconfig"

endif # NET_VENDOR_LANTIQ
```

## release/src-lantiq/linux/linux-3.10.104/drivers/net/ethernet/lantiq/cbm/Kconfig
```kconfig
#
# Central Buffer Manager(CBM) configuration
#

menu "CBM"

config LTQ_CBM
        tristate "Central Buffer Manager Driver"
	depends on SOC_GRX500
        default n
        ---help---
          Turn on this option to enable CBM driver which is a special hardware
	  present in the XRX500 series of SoCs to manage the network buffers
	  in HW.

config CBM_STD_BUF_POOL_SIZE
	hex "CBM Standard Buffer pool size"
	depends on LTQ_CBM
	default 0x200000

config CBM_JBO_BUF_SIZE 
	hex "CBM Jumbo Buffer pool size"
	depends on LTQ_CBM
	default 0x800000

config CBM_JBO_PKT_SIZE 
	hex "CBM Jumbo Packet size"
	depends on LTQ_CBM
	default 0x2000
config CBM_LS_ENABLE
    tristate "CBM loadspreader"
	depends on LTQ_CBM
    default n
        ---help---
          Turn on this option to enable CBM LS and TCP packet Marking
	  in HW.
endmenu
```
