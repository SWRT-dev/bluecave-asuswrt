## release/src-lantiq/linux/linux-3.10.104/drivers/net/ethernet/lantiq/datapath/Kconfig
```kconfig
#
# Datapath Lib
#
config LTQ_DATAPATH
	bool "Datapath Lib"
	default y
	depends on SOC_GRX500
	---help---
	  Datapath Lib is to provide common rx/tx wrapper API without taking
	  care of much HW knowledge and also provide common interface for legacy
	  devices and different HW like to CBM or LRO.
	  Take note: All devices need to register to datapath API first

config LTQ_DATAPATH_MIB
	bool "Datapath aggregated mib support"
	depends on LTQ_DATAPATH
	default y
	---help---
	   It is to aggregate GSWIP-L/R, TMU and driver's MIB counter
config LTQ_DATAPATH_MIB_TMU_MPE_MIB
        bool "Support TMU-HAL mib API and MPE_HAL mib API"
        default y
        depends on LTQ_DATAPATH_MIB
        ---help---
          it is to provide dummpy TMU HAL mib api for standalone testing only
config LTQ_DATAPATH_DUMMY_TMU_MIB
	bool "Dummy TMU-HAL mib API"
	default n
	depends on LTQ_DATAPATH_MIB_TMU_MPE_MIB
	---help---
	  it is to provide dummpy TMU HAL mib api for standalone testing only
config LTQ_DATAPATH_DUMMY_MPE_MIB
        bool "Dummy MPE-HAL mib API"
        default n
        depends on LTQ_DATAPATH_MIB_TMU_MPE_MIB
        ---help---
          it is to provide dummpy MPE HAL mib api for standalone testing only
config LTQ_DATAPATH_OLD_TMU_HAL
        bool "Integrate with non-standard TMU HAL"
        default n
        depends on LTQ_DATAPATH_MIB_TMU_MPE_MIB
        ---help---
          it is to used to do integraion with non-standard TMU HAL. For testing only with old TMU HAL
config LTQ_DATAPATH_CPUFREQ
        bool "Datapath DFS(COC) support"
        depends on LTQ_DATAPATH && LTQ_CPUFREQ
        default y
        ---help---
           It is to support DFS(COC) in Datapath
config LTQ_DP_ACA_CSUM_WORKAROUND
	bool "ACA Checksum Workaround"
	default y
	---help---
	  It is to solve system bus hang hang issue 

config LTQ_DATAPATH_MANUAL_PARSE
        bool "Datapath manual parse network protocol"
        depends on LTQ_DATAPATH
        default y
        ---help---
           Manual parse network protocol for tcp offloading with some tunnel limit

config LTQ_DATAPATH_COPY_LINEAR_BUF_ONLY
        bool "Datapath Copy linear buffer only for skb"
        default n
        ---help---
           Datapath Copy linear buffer only for skb if need to alloc new buffer. But it needs CBM driver supports


config LTQ_DATAPATH_DBG
	bool "Datapath Debug Tool"
	default y
	depends on LTQ_DATAPATH
	---help---
	  Datapath Debug Tool is used to provide simple debug proc tool
	  Each flag can be enabled/disabled easily
	  Once this flag is enabled, the debugging information will be printed out
	  otherwise, no debugging information for this flag will be printed

config LTQ_DATAPATH_DBG_PROTOCOL_PARSE
        bool "Datapath Debug Tool for hw checksum's protocol parsing"
        default n
        depends on LTQ_DATAPATH_DBG
        ---help---
          Datapath Debug Tool for hw checksum's protocol parsing

config LTQ_DATAPATH_LOOPETH
	bool "pseudo driver simulation"
	default n
	depends on LTQ_DATAPATH
	---help---
	  Pseudo driver is to simulate ethernet/wifi device to register to datapath
	  api. Use this pseudo driver can test whether datatpath API is implemented
	  properly or not.
	  Also it can be used to measure the directpath performance

config LTQ_DP_MPE_FASTHOOK_TEST
	bool "MPE FW Fast Hook Test for skb"
	default n
	depends on  LTQ_DATAPATH
	---help---
	  MPE FW Fast Hook is used to quick verify MPE FW Functionality without
	  fullPPA support. Once it is enabled, it will add some fields in skb structure
	  in order to support MPE FAST HOOK. The reason is that some network driver is
	  pre-build out of this build system.

config LTQ_DP_MPE_FASTHOOK_TEST_COMPILE
        bool "MPE FW Fast Hook Test"
        default n
        depends on  LTQ_DP_MPE_FASTHOOK_TEST
        ---help---
          MPE FW Fast Hook is used to quick verify MPE FW Functionality without
          fullPPA support. It will install two hook in dp_rx/dp_xmit API and
          quickly learn session informatin. Once the session is learned,
          it will configure MPE FW session table, ie, the compare table and
          test MPE FW functionalities.
```

## release/src-lantiq/linux/linux-3.10.104/drivers/net/ethernet/lantiq/directconnect_dp/Kconfig
```kconfig
#
# DirectConnect Datapath Driver
#
config LTQ_DIRECTCONNECT_DP
	tristate "Lantiq DirectConnect Datapath driver for XRX500 series"	
	default n
	depends on LANTIQ && SOC_GRX500 && LTQ_DATAPATH && LTQ_HWMCPY
	---help---
	  Lantiq DirectConnect Datapath driver for XRX500 series. 

config LTQ_DIRECTCONNECT_DP_DBG
	bool "Datapath Debug Tool"
	default y
	depends on LTQ_DIRECTCONNECT_DP
	---help---
	  Directconnect Datapath Debug Tool is used to provide simple debug proc tool
	  Each flag can be enabled/disabled easily
	  Once this flag is enabled, the debugging information will be printed out
	  otherwise, no debugging information for this flag will be printed
```

## release/src-lantiq/linux/linux-3.10.104/drivers/net/ethernet/lantiq/tmu/Kconfig
```kconfig
#
# TMU
#

menu "TMU"

config LTQ_TMU
	bool "TMU QoS Support. It is a must if CBM is enabled"
	depends on SOC_GRX500
	default y
	---help---
	  TMU QoS Support

#config LTQ_TMU_DEVICE_TREE
#	bool "Use Device Tree for TMU"
#	depends on LTQ_TMU
#	default n
#	---help---
#	  For testing purpose since CBM will call tmu_ll_init

config LTQ_TMU_DDR_SIMULATE_REG
	bool "Use DDR to Simulate TMU HW Register for testing purpose"
	depends on LTQ_TMU
	default n
	---help---
	  Use DDR to Simulate TMU HW Register for testing purpose

endmenu
```

## release/src-lantiq/linux/linux-3.10.104/drivers/net/ethernet/lantiq/vrx318/Kconfig
```kconfig
#
#VRX318 driver
#
menu "VRX318"

config VRX318_DATAPATH
	bool "VRX318 datapath driver"
	depends on LTQ_DATAPATH && LTQ_CBM && LANTIQ_VRX318
	default n
	---help---
	  VRX318 is PCIe endpoint providing ATM/PTM/PTM bonding functions.
	  datapth built in kernel to provide consistent API support for
	  MEI driver or other SoC required API support.
	  Supporting APIs for differnt SoC platforms should be put
	  in this part.

config VRX318_TC
	tristate "VRX318 ATM/PTM/BONDING TC"
	depends on VRX318_DATAPATH
	default n
	---help---
	  Support ATM/PTM/Bonding TC based on VRX318 datapath framework
	  it merged ATM/PTM/Bonding function in one module.
	  TC switch from ATM to PTM/Bonding or vice versa can be requested via
	  API call or proc.

endmenu
```

## release/src-lantiq/linux/linux-3.10.104/drivers/net/lantiq_ptm/Kconfig
```kconfig
config LTQ_PTM
	tristate "Lantiq PTM driver"
	depends on LANTIQ
	default n
	---help---
	Use this exclusively with ATM mode or Acceleration Package

choice
	prompt "RX Packet Handling Mechanism"
	depends on LTQ_PTM
	default LTQ_PTM_RX_NAPI

config LTQ_PTM_RX_NAPI
	bool "NAPI"

config LTQ_PTM_RX_TASKLET
	bool "Tasklet"
	depends on LTQ_PTM_XRX200

config LTQ_PTM_RX_INTERRUPT
	bool "Interrupt"
	depends on LTQ_PTM_XRX200

endchoice

config LTQ_PTM_TEST_PROC
	bool "Lantiq PTM Driver Test Proc"
	depends on LTQ_PTM
	default n

config LTQ_PTM_XRX200
	bool "PTM Platform Selection"
	depends on LTQ_PTM
	default y
```

## release/src-lantiq/linux/linux-3.10.104/drivers/usb/ltq_dwc2/Kconfig
```kconfig
#config USB_DWC2_CORE
#	tristate

config USB_DWC2_COMMON_PORT
	tristate

config USB_LTQ_DWC2
	tristate "LTQ DWC2 Core Support"
	depends on USB
	select USB_DWC2_COMMON_PORT 
#	select USB_DWC2_CORE
	help
	  Say Y or M here if your system has a Dual Role HighSpeed
	  USB controller based on the DesignWare HSOTG IP Core.

	  If you choose to build this driver as dynamically linked
	  modules, the core module will be called dwc2.ko, the
	  PCI bus interface module (if you have a PCI bus system)
	  will be called dwc2_pci.ko and the platform interface module
	  (for controllers directly connected to the CPU) will be called
	  dwc2_platform.ko.

	  NOTE: This driver at present only implements the Host mode
	  of the controller. The existing s3c-hsotg driver supports
	  Peripheral mode, but only for the Samsung S3C platforms.
	  There are plans to merge the s3c-hsotg driver with this
	  driver in the near future to create a dual-role driver.

if USB_LTQ_DWC2

config USB_LTQ_DWC2_DEBUG
	bool "Enable LTQ DWC2 Debugging Messages"
	help
	  Say Y here to enable debugging messages in the DWC2 Driver.

endif # USB_LTQ_DWC2
```

## release/src-lantiq/linux/linux-3.10.104/net/lantiq/Kconfig
```kconfig
#
# mcast_helper configuration
#


config LANTIQ_MCAST_HELPER
	tristate "Multicast Helper support"
	default m
	help
		mcast_helper support

config LANTIQ_MCAST_HELPER_ACL
	tristate "Multicast Helper ACL support"
        default y
        help
                mcast_helper ACL support
	
config LANTIQ_MCAST_HELPER_M2U
	tristate "Multicast Helper multicast to unicast support"
        default y
        help
                mcast_helper update multicast to unicast support
```

## release/src-lantiq/linux/linux-3.10.104/net/lantiq/stat_helper/Kconfig
```kconfig
#
# Stat helper configuration
#

config LTQ_STAT_HELPER
	bool "Stat Helper support"
	default n
	help
		Stat helper support

choice
   prompt "Stat Helper Platform Selection"
   default LTQ_STAT_HELPER_XRX330
   
   config LTQ_STAT_HELPER_XRX200
      depends on LTQ_STAT_HELPER
      bool "xRX200"

   config LTQ_STAT_HELPER_XRX300
      depends on LTQ_STAT_HELPER
      bool "xRX300"
   
   config LTQ_STAT_HELPER_XRX330
      depends on LTQ_STAT_HELPER
      bool "xRX330"

endchoice
```
